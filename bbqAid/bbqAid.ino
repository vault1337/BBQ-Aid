#include <SPI.h>
#include "Adafruit_MAX31855.h"
#include <Adafruit_GFX.h>
#include <Adafruit_SSD1306.h>

void initSerial(void);
bool initOled(void);
bool initThermocouple(void);

void updateTemperature(bool fahrenheit = false);

#define LOW_TEMP_WARNING    100
#define HIGH_TEMP_WARNING   130

#define UPDATE_INTERVAL_MS  1000

#define THERMOCOUPLE_CS   4

#define SCREEN_WIDTH 128
#define SCREEN_HEIGHT 32
#define SCREEN_ADDRESS 0x3C 

Adafruit_MAX31855 thermocouple(THERMOCOUPLE_CS);
Adafruit_SSD1306 display(SCREEN_WIDTH, SCREEN_HEIGHT, &Wire, 5);

const unsigned char logo [] PROGMEM=
{
  0x00, 0x00, 0x00, 0x00, 0x00, 0x00, 0x00, 0x00, 0x00, 0x00, 0x00, 0x00, 0x03, 0x83, 0x03, 0x00, 
  0x00, 0x00, 0x00, 0x00, 0x00, 0x00, 0x00, 0x00, 0x00, 0x00, 0x00, 0x00, 0x01, 0xc3, 0x83, 0x80, 
  0x00, 0x00, 0x00, 0x00, 0x00, 0x00, 0x00, 0x00, 0x00, 0x00, 0x00, 0x00, 0x00, 0xe1, 0xc1, 0xc0, 
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  0x00, 0x00, 0x00, 0x00, 0x00, 0x00, 0x00, 0x00, 0x00, 0x00, 0x00, 0x00, 0x00, 0x00, 0x00, 0x00
};

const unsigned char warning [] PROGMEM=
{
  0x00, 0x00, 0x00, 0x00, 0x00, 0x00, 0x00, 0x00, 0x00, 0x01, 0x80, 0x00, 0x00, 0x01, 0x80, 0x00, 
  0x00, 0x03, 0xc0, 0x00, 0x00, 0x03, 0xe0, 0x00, 0x00, 0x07, 0xe0, 0x00, 0x00, 0x0f, 0xf0, 0x00, 
  0x00, 0x0e, 0x70, 0x00, 0x00, 0x1e, 0x78, 0x00, 0x00, 0x1c, 0x38, 0x00, 0x00, 0x3c, 0x3c, 0x00, 
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  0x7f, 0xff, 0xff, 0xfe, 0x7f, 0xff, 0xff, 0xfe, 0xff, 0xff, 0xff, 0xff, 0x00, 0x00, 0x00, 0x00
};


uint64_t task = 0;
double temperature;

void setup() 
{
  initSerial();
  bool oledInited = initOled();
  bool sensorInited = initThermocouple();

  if(oledInited == false)
  {
    Serial.println("Display failed to initialize!");
    while(true);
  }
  else if(sensorInited == false)
  {
    display.clearDisplay();
    display.setTextSize(1);
    display.print("Failed to initialize the sensor!");
    display.display();
    while(true);
  }

  task = millis();
}

void loop() 
{
  if(millis() >= task)
  {
    task += UPDATE_INTERVAL_MS;
    updateTemperature(); // change to updateTemperature(true); for Fahrenheit
  }
}


void initSerial(void)
{
  Serial.begin(115200);
  Serial.println("Power On!");
}

bool initOled(void)
{
  if(display.begin(SSD1306_SWITCHCAPVCC, SCREEN_ADDRESS))
  {
    display.setTextSize(3);
    display.setTextColor(SSD1306_WHITE);
    display.cp437(true);
    display.setCursor(0, 0);
    
    display.clearDisplay();
    display.display();  
    display.drawBitmap(0, 0, logo, SCREEN_WIDTH, SCREEN_HEIGHT, 1);
    display.display();
    delay(3000);
    return true;
  }
  else
  {
    return false;
  }
  
}

bool initThermocouple(void)
{
  return thermocouple.begin();
}

void updateTemperature(bool fahrenheit)
{
  
  
  if(fahrenheit)
  {
    temperature = thermocouple.readFahrenheit();
  }
  else
  {
    temperature = thermocouple.readCelsius();
  }
  
  if(isnan(temperature) == false)
  {
    display.clearDisplay();
    display.setCursor(0, 8);
    Serial.println(temperature);
    int rounded = (int)temperature;
    display.print(rounded);
    display.print((char)248);
    if(fahrenheit)
    {
      display.print("F");
    }
    else
    {
      display.print("C");
    }
    if(temperature < LOW_TEMP_WARNING || temperature > HIGH_TEMP_WARNING)
    {
      display.drawBitmap(95, 0, warning, 32, 32, 1);
    }
    display.display(); 
  }
}
